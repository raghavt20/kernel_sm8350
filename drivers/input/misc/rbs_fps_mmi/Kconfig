## drivers/input/misc/rbs_fps_mmi/Kconfig
```kconfig
config PANEL_NOTIFICATIONS
	bool "Panel Notifications"
	default n
	help
	  Say Y here to enable support for panel notifications.
	  If unsure, say N.

config ET721_FOD
	bool "ET721 FOD"
	default n
	help
	  Say Y here to enable support for ET721 FOD.
	  If unsure, say N.

config RBS_FPS_MMI
	tristate "RBS FPS MMI"
	default n
	help
	  Say Y here to build the RBS FPS MMI driver as a module.
	  If unsure, say N.
```

## drivers/input/touchscreen/goodix_berlin_mmi/Kconfig
```kconfig
config TOUCHSCREEN_GOODIX_BRL_SPI
	bool "Goodix BRL SPI Touchscreen"
	default n
	help
	  Say Y here to enable support for Goodix BRL SPI touchscreen.
	  If unsure, say N.

config GTP_FOD
	bool "Goodix FOD Gesture"
	default n
	help
	  Say Y here to enable support for Goodix FOD gesture.
	  If unsure, say N.

config GTP_LIMIT_USE_SUPPLIER
	bool "Goodix Limit Use Supplier"
	default n
	help
	  Say Y here to enable support for Goodix limit use supplier.
	  If unsure, say N.

config GTP_ENABLE_PM_QOS
	bool "Goodix Enable PM QoS"
	default n
	help
	  Say Y here to enable support for Goodix PM QoS.
	  If unsure, say N.

config GOODIX_ESD_ENABLE
	bool "Goodix ESD Enable"
	default n
	help
	  Say Y here to enable support for Goodix ESD.
	  If unsure, say N.

config GTP_LAST_TIME
	bool "Goodix Last Time"
	default n
	help
	  Say Y here to enable support for Goodix last time.
	  If unsure, say N.

config GTP_DDA_STYLUS
	bool "Goodix DDA Stylus"
	default n
	help
	  Say Y here to enable support for Goodix DDA stylus.
	  If unsure, say N.

config TOUCHSCREEN_GOODIX_BRL_MMI
	tristate "Goodix BRL MMI Touchscreen"
	depends on I2C
	default n
	help
	  Say Y here to build the Goodix BRL MMI touchscreen driver as a module.
	  If unsure, say N.
```

## drivers/input/touchscreen/touchscreen_mmi/Kconfig
```kconfig
config PANEL_NOTIFICATIONS
	bool "Panel Notifications"
	default n
	help
	  Say Y here to enable support for panel notifications.
	  If unsure, say N.

config DRM_DYNAMIC_REFRESH_RATE
	bool "DRM Dynamic Refresh Rate"
	default n
	help
	  Say Y here to enable support for DRM dynamic refresh rate.
	  If unsure, say N.

config TOUCHCLASS_MMI_DEBUG_INFO
	bool "Touchclass MMI Debug Info"
	default n
	help
	  Say Y here to enable support for touchclass MMI debug information.
	  If unsure, say N.

config TOUCHCLASS_MMI_GESTURE_POISON_EVENT
	bool "Touchclass MMI Gesture Poison Event"
	default n
	help
	  Say Y here to enable support for touchclass MMI gesture poison event.
	  If unsure, say N.

config TOUCHCLASS_MMI_MULTIWAY_UPDATE_FW
	bool "Touchclass MMI Multiway Update FW"
	default n
	help
	  Say Y here to enable support for touchclass MMI multiway firmware update.
	  If unsure, say N.

config DRM_PANEL_NOTIFICATIONS
	bool "DRM Panel Notifications"
	default n
	help
	  Say Y here to enable support for DRM panel notifications.
	  If unsure, say N.

config DRM_PANEL_EVENT_NOTIFICATIONS
	bool "DRM Panel Event Notifications"
	default n
	help
	  Say Y here to enable support for DRM panel event notifications.
	  If unsure, say N.

config TS_KERNEL_USE_GKI
	bool "Touchscreen Kernel Use GKI"
	default n
	help
	  Say Y here to enable support for touchscreen kernel using GKI.
	  If unsure, say N.

config BOARD_USES_DOUBLE_TAP_CTRL
	bool "Board Uses Double Tap Control"
	default n
	help
	  Say Y here if the board uses double tap control.
	  If unsure, say N.

config TOUCHSCREEN_MMI
	tristate "Touchscreen MMI"
	depends on I2C
	default n
	help
	  Say Y here to build the Touchscreen MMI driver as a module.
	  If unsure, say N.
```
